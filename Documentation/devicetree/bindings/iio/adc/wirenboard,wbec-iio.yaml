## Documentation/devicetree/bindings/iio/adc/wirenboard,wbec-iio.yaml
```yaml
# SPDX-License-Identifier: (GPL-2.0 OR BSD-2-Clause)
%YAML 1.2
---
$id: http://devicetree.org/schemas/iio/adc/wirenboard,wbec-iio.yaml#
$schema: http://devicetree.org/meta-schemas/core.yaml#

title: Wiren Board Embedded Controller ADC Driver

maintainers:
  - Pavel Gasheev <pavel.gasheev@wirenboard.ru>

description: |
  The WB EC ADC describes the ADC block included in the WB EC.

properties:
  compatible:
    const: wirenboard,wbec-iio

  reg:
    const: 0

  "#io-channel-cells":
    const: 1

required:
  - compatible
  - reg
  - "#io-channel-cells"

additionalProperties: false

examples:
  - |
    wbec_iio: wbec-iio@0 {
      compatible = "wirenboard,wbec-iio";
      reg = <0>;
      #io-channel-cells = <1>;
    };
...
```

## Documentation/devicetree/bindings/leds/wirenboard,wbec-led.yaml
```yaml
# SPDX-License-Identifier: GPL-2.0
%YAML 1.2
---
$id: http://devicetree.org/schemas/leds/wirenboard,wbec-led.yaml#
$schema: http://devicetree.org/meta-schemas/core.yaml#

title: Wiren Board Embedded Controller System LED Driver

maintainers:
  - Ilia Skochilov <ilia.skochilov@wirenboard.com>

description: |
  Enables access to the System LED on the Wiren Board Embedded Controller

properties:
  compatible:
    const: wirenboard,wbec-led

  reg:
    const: 0

required:
  - compatible
  - reg

additionalProperties: false

examples:
  - |
    wbec-led@0 {
      compatible = "wirenboard,wbec-led";
      reg = <0>;
    };
...
```

## Documentation/devicetree/bindings/mfd/wbec.txt
```
Wiren Board Embedded Controller

Required properties:
- compatible: "wirenboard,wbec"

Optional properties:
- wakeup-source:  Set for ability to power off and wakeup with alarm
- gpio-controller:  Register GPIO driver
- ngpios:  Number of used GPIOs (from common GPIO bindings)
- gpio-line-names:  GPIO names (from common GPIO bindings)


Example:
	wbec: wbec@0 {
		spi-max-frequency = <1000000>;

		compatible = "wirenboard,wbec";
		reg = <0>;
		status = "okay";
		#address-cells = <1>;
		#size-cells = <0>;

		wakeup-source;

		gpio-controller;
		#gpio-cells = <2>;
		ngpios = <6>;
		gpio-line-names = "EC A1", "EC A2", "EC A3", "EC A4", "EC V OUT", "EC WBMZ STATUS";
	};
```

## Documentation/devicetree/bindings/timer/fsl,imxgpt.txt
```
Freescale i.MX General Purpose Timer (GPT)

Required properties:

- compatible : should be "fsl,<soc>-gpt"
- reg : Specifies base physical address and size of the registers.
- interrupts : A list of 4 interrupts; one per timer channel.
- clocks : The clocks provided by the SoC to drive the timer.

Optional properties:

- pinctrl-0: For the i.MX GPT to support the Input Capture function,
  	     the input capture channel pin groups must be listed here.
- pinctrl-names: must be "default".


Example:

gpt1: timer@10003000 {
	compatible = "fsl,imx27-gpt", "fsl,imx1-gpt";
	reg = <0x10003000 0x1000>;
	interrupts = <26>;
	clocks = <&clks 46>, <&clks 61>;
	clock-names = "ipg", "per";
};


Example with input capture channel 0 support:

pinctrl_gpt_input_capture0: gptinputcapture0grp {
	fsl,pins = <
		MX6QDL_PAD_SD1_DAT0__GPT_CAPTURE1 0x1b0b0
	>;
};

gpt: gpt@2098000 {
	compatible = "fsl,imx6q-gpt", "fsl,imx31-gpt";
	reg = <0x02098000 0x4000>;
	interrupts = <0 55 IRQ_TYPE_LEVEL_HIGH>;
	clocks = <&clks IMX6QDL_CLK_GPT_IPG>,
		<&clks IMX6QDL_CLK_GPT_IPG_PER>,
		<&clks IMX6QDL_CLK_GPT_3M>;
	clock-names = "ipg", "per", "osc_per";
	pinctrl-names = "default";
	pinctrl-0 = <&pinctrl_gpt_input_capture0>;
};
```

## Documentation/devicetree/bindings/w1/w1-gpio.yaml
```yaml
# SPDX-License-Identifier: GPL-2.0
%YAML 1.2
---
$id: http://devicetree.org/schemas/w1/w1-gpio.yaml#
$schema: http://devicetree.org/meta-schemas/core.yaml#

title: Bitbanged GPIO 1-Wire Bus

maintainers:
  - Daniel Mack <zonque@gmail.com>

properties:
  compatible:
    const: w1-gpio

  gpios:
    minItems: 1
    items:
      - description: Data I/O pin
      - description: Enable pin for an external pull-up resistor

  pu-gpios:
    minItems: 1
    maxItems: 1
    items:
      - description: External strong pull-up enable pin
      - description: Enable pin for an external strong pull-up FET. if not specified, data I/O pin will be used in output mode to emulate strong pull-up.

  linux,open-drain:
    type: boolean
    description: >
      If specified, the data pin is considered in open-drain mode.

required:
  - compatible
  - gpios

additionalProperties:
  type: object

examples:
  - |
    #include <dt-bindings/gpio/gpio.h>

    onewire {
        compatible = "w1-gpio";
        gpios = <&gpio 0 GPIO_ACTIVE_HIGH>;
    };

...
```

## drivers/staging/wirenboard/Kconfig
```kconfig
config IMX_GPT_FREQ
    depends on CLKSRC_IMX_GPT
	tristate "Frequency measurement using IMX GPT Timer capture/compare"
```
