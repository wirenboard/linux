/dts-v1/;
#include "sun8i-r40-wirenboard72x-initram.dtsi"

/* This DTS is used at production/init stage. For FIT bootlets, use sun8i-r40-wirenboard72x-bootlet.dts */

/ {
	model = "Wiren Board rev. 7.x (A40i), initramfs";
	compatible = "wirenboard,wirenboard-74x-initram", "wirenboard,wirenboard-720-initram", "wirenboard,wirenboard-720", "wirenboard,wirenboard-72x", "wirenboard,wirenboard-700", "wirenboard,wirenboard-7xx", "allwinner,sun8i-r40";
};

/*
	Since wb7.2+, this port set for lower usb speed (for more stable debug-network).
	While performing init-magic, we need max possible usb speed.
*/
&usb_otg {
	/delete-property/ maximum-speed;
};
